## meta-jsos/conf/layer.conf
```bitbake
# We have a conf and classes directory, add to BBPATH
BBPATH .= ":${LAYERDIR}"

# We have a recipes directory, add to BBFILES
BBFILES += "${LAYERDIR}/recipes-*/*/*.bb \
	    ${LAYERDIR}/recipes-*/*/*.bbappend"

BBFILE_COLLECTIONS += "jsos"
BBFILE_PATTERN_jsos := "^${LAYERDIR}/"
BBFILE_PRIORITY_jsos = "9"
```
